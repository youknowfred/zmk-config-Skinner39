## Kconfig
```kconfig
# Repo-root Zephyr-module Kconfig (mounted via zephyr/module.yml `build.kconfig`).
# Sourced into every target's Kconfig tree — all symbols here must default off
# or be gated so non-Glance builds are unaffected.

rsource "vendor/zmk-raw-hid/Kconfig"

config KEYSMITH_STATUS_REPORTS
    bool "Keysmith status reports — device->host layer/battery frames over raw-HID"
    depends on RAW_HID_BLE
    help
      Emits 32-byte input reports on the Glance raw-HID collection:
      tag 0xB8 = active-layer bitmask (on change + 15 s heartbeat),
      tag 0xB9 = central + fetched-peripheral battery (on change + 60 s
      heartbeat). Device->host only; the locked host->device Glance
      schema (0xB0-0xB5) is untouched. The keysmith TB-7 channel —
      ground-truth layer attribution + the M11 battery guardrail source.
      Spec: docs/2026-06-12-status-report-channel.md.
```

## boards/shields/keysmith_glance/Kconfig.shield
```kconfig
# Copyright (c) 2022 The ZMK Contributors
# SPDX-License-Identifier: MIT

config SHIELD_KEYSMITH_GLANCE
    def_bool $(shields_list_contains,keysmith_glance)
```

## boards/yangxing/skinner39/Kconfig.defconfig
```kconfig
# Copyright (c) 2020 The ZMK Contributors
# SPDX-License-Identifier: MIT

if BOARD_SKINNER39_LEFT

config ZMK_KEYBOARD_NAME
    default "SKINNER39"

config ZMK_SPLIT_ROLE_CENTRAL
    default y

endif # BOARD_SKINNER39_LEFT

if BOARD_SKINNER39_LEFT || BOARD_SKINNER39_RIGHT

config BOARD
    default "skinner39"

config ZMK_SPLIT
    default y

config BT_CTLR
    default BT

if USB

config USB_NRFX
    default y

config USB_DEVICE_STACK
    default y

endif # USB

if LVGL

config ZMK_DISPLAY_DEDICATED_THREAD_STACK_SIZE
    default 8192

config LV_Z_VDB_SIZE
    default 64

config LV_DPI_DEF
    default 148

config LV_Z_BITS_PER_PIXEL
    default 1

choice LV_COLOR_DEPTH
    default LV_COLOR_DEPTH_1
endchoice

endif # LVGL

config SPI
    default y

endif # BOARD_SKINNER39_LEFT || BOARD_SKINNER39_RIGHT
```

## boards/yangxing/skinner39/board.yml
```yaml
boards:
  - name: skinner39_left
    vendor: yangxing
    socs:
      - name: nrf52840
        variants:
          - name: zmk
  - name: skinner39_right
    vendor: yangxing
    socs:
      - name: nrf52840
        variants:
          - name: zmk
```

## config/boards/arm/skinner39/Kconfig.board
```kconfig
# mikoto board configuration

# Copyright (c) 2020 The ZMK Contributors
# SPDX-License-Identifier: MIT

config BOARD_SKINNER39_LEFT
    bool "skinner39 keyboard left"
    depends on SOC_NRF52840_QIAA



config BOARD_SKINNER39_RIGHT
    bool "skinner39 keyboard right"
    depends on SOC_NRF52840_QIAA
```

## config/west.yml
```yaml
manifest:
  remotes:
    - name: zmk
      url-base: https://github.com/zmkfirmware
    - name: badjeff
      url-base: https://github.com/badjeff
    # T1-A: pointer acceleration module
    - name: oleksandrmaslov
      url-base: https://github.com/oleksandrmaslov
    # T1-E: 1-Euro smoothing module (your repo)
    - name: youknowfred
      url-base: https://github.com/youknowfred
  projects:
    - name: zmk
      remote: youknowfred
      revision: f140857df6390ebfb62f0371296f854fc83d0182  # CURE-v2 lineage (d62e565c five-wedge split-reconnect fix) + the defused-DBG recorder (per-event hot-path LOG_DBG deleted at source, now incl. the held-layer scaler/code-mapper pair) + 32 KB black-box log ring (battery-mode trap: plug cable first, power-cycle last) + host-link disconnect WRN filter. Prev pin 13b4175c. REVERT = remote: zmk / revision: 26246da1b69733b224a33d82b33750541cd5933a
      import: app/west.yml
    - name: zmk-pmw3610-driver
      remote: badjeff
      revision: 44b4a76b74d293a93cec4ccb7e04cb8d29c10f93  # main / "zmk-0.4": pixart,pmw3610-alt + CONFIG_PMW3610_ALT_*
    # T1-A: pointer acceleration (pinned; pre-1.0, Cirque-tested)
    - name: zmk-pointing-acceleration
      remote: oleksandrmaslov
      revision: 0da8f97f8f2abb18fcc9d488b25357511922cf32  # main @ 2026-06
    # T1-E: 1-Euro smoothing (custom; DRAFT — soak before trusting)
    - name: zmk-input-processor-one-euro
      remote: youknowfred
      revision: 6f9c5432bb7a8cc55169ee945a6fca8824569670
    # P0-6 raw-HID (keysmith Glance host channel): VENDORED 2026-06-12, no longer a
    # west project — see vendor/zmk-raw-hid/ (upstream zzeneg/zmk-raw-hid @ e25e325a
    # + the RAW_HID_USB/RAW_HID_BLE transport split), mounted via the repo-root
    # module (zephyr/module.yml build.cmake/kconfig). BLE-first per the 2026-06-10
    # bisect: the legacy USB stack dies under the CDC+2xHID composite, so LEFT
    # Glance builds run -DCONFIG_RAW_HID=y -DCONFIG_RAW_HID_USB=n (HID-over-GATT
    # only, zero USB delta). The legacy-vs-usbd port note still stands for the USB
    # transport: re-check when zmk migrates to USB_DEVICE_STACK_NEXT.
  self:
    path: config
# Dropped vs fw15 (now built into ZMK core, were breaking the build):
#   zmk-split-peripheral-input-relay  -> core `zmk,input-split`
#   zmk-input-behavior-listener       -> core `zmk,input-listener` + input-processors
#   zmk-lpm009m360a-driver            -> unused (display is nice_view)
```

## modules/zmk-input-processor-one-euro/dts/bindings/zmk,input-processor-one-euro.yaml
```yaml
# SPDX-License-Identifier: MIT
# DRAFT — 1-Euro adaptive low-pass smoothing for relative pointer input (T1-E).
description: 1-Euro pointer smoothing input processor (DRAFT — compile + soak before use)

compatible: "zmk,input-processor-one-euro"

include: ip_zero_param.yaml   # zero-cell input processor base (#input-processor-cells = <0>)

properties:
  input-type:
    type: int
    default: 2   # INPUT_EV_REL
    description: Input event type to smooth (INPUT_EV_REL = 2).

  min-cutoff-milli:
    type: int
    default: 1000   # 1.0 Hz
    description: Minimum cutoff frequency in milli-Hz. Lower = more smoothing at rest, more lag.

  beta-milli:
    type: int
    default: 7
    description: Speed coefficient (milli). Higher = cutoff rises faster with speed = less lag on fast motion. Sweep {3,7,15}.

  d-cutoff-milli:
    type: int
    default: 1000   # 1.0 Hz
    description: Derivative cutoff frequency in milli-Hz.

  ema-only:
    type: boolean
    description: Use a fixed-alpha EMA instead of full 1-Euro. The simpler "A-arm" — try this first.

  ema-alpha-milli:
    type: int
    default: 400   # 0.4
    description: EMA weight (0..1000) for the new sample when ema-only is set.
```

## modules/zmk-input-processor-one-euro/src/Kconfig
```kconfig
# SPDX-License-Identifier: MIT
DT_COMPAT_ZMK_INPUT_PROCESSOR_ONE_EURO := zmk,input-processor-one-euro

config ZMK_INPUT_PROCESSOR_ONE_EURO
    bool "Enable 1-Euro pointer smoothing input processor (DRAFT)"
    default $(dt_compat_enabled,$(DT_COMPAT_ZMK_INPUT_PROCESSOR_ONE_EURO))
    depends on ZMK_POINTING
    depends on INPUT
    help
      DRAFT (T1-E). Adaptive low-pass (1-Euro) smoothing of relative pointer deltas.
      This draft uses floating point — also enable CONFIG_FPU=y. Bump
      CONFIG_MAIN_STACK_SIZE=4096 before enabling, and soak before trusting it.
```

## vendor/zmk-raw-hid/Kconfig
```kconfig
config RAW_HID
    bool "Enable Raw HID"
    depends on !ZMK_SPLIT || ZMK_SPLIT_ROLE_CENTRAL

config RAW_HID_USB
    bool "Raw HID transport over USB HID"
    depends on RAW_HID
    default y
    imply USB_DEVICE_HID
    help
      Compile the USB HID transport (src/usb_hid.c). Uses the legacy
      hid_ops/usb_hid_register_device API and binds the additional HID
      instance named by RAW_HID_DEVICE, so a keyboard build needs
      CONFIG_USB_HID_DEVICE_COUNT=2. Disable for a BLE-only
      (HID-over-GATT) build that leaves USB enumeration untouched.

config RAW_HID_BLE
    bool "Raw HID transport over BLE HID-over-GATT"
    depends on RAW_HID && ZMK_BLE
    default y
    help
      Compile the HID-over-GATT transport (src/hog.c): a second HID
      service instance carrying the vendor report map, notifying on the
      active profile's connection. Adds no USB endpoints.

config RAW_HID_USAGE_PAGE
    hex "Raw HID Usage Page"
    default 0xFF60

config RAW_HID_USAGE
    hex "Raw HID Usage"
    default 0x61

config RAW_HID_REPORT_SIZE
    int "Raw HID Report Size"
    default 32

config RAW_HID_DEVICE
    string "Raw HID Device"
    default HID_1
```
